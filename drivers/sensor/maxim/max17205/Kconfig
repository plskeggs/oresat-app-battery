## drivers/sensor/maxim/max17205/Kconfig
```kconfig
# Copyright 2020 Matija Tudan
#
# SPDX-License-Identifier: Apache-2.0

config MAX17205
	bool "MAX17205 Fuel Gauge"
	default y
	depends on DT_HAS_MAXIM_MAX17205_ENABLED
	select I2C
	help
	  Enable I2C-based driver for MAX17205 Fuel Gauge. This driver supports
	  reading various sensor settings including voltage, current, temperature,
	  time to full/empty and remaining capacity in mAh.
```
